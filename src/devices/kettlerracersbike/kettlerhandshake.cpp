#include "kettlerhandshake.h"

#include <QRandomGenerator>

#include <algorithm>
#include <array>

namespace {
constexpr std::array<unsigned char, 16> kKettlerKey = {
    static_cast<unsigned char>('K'),
    static_cast<unsigned char>('a'),
    static_cast<unsigned char>('l'),
    static_cast<unsigned char>('N'),
    static_cast<unsigned char>('h'),
    static_cast<unsigned char>('y'),
    static_cast<unsigned char>('a'),
    static_cast<unsigned char>('w'),
    static_cast<unsigned char>('t'),
    static_cast<unsigned char>('I'),
    static_cast<unsigned char>('k'),
    static_cast<unsigned char>('9'),
    0x00, 0x00, 0x00, 0x00
};
}

namespace kettler {

QByteArray buildHandshakeSeed(const QByteArray &sessionSeed)
{
    if (sessionSeed.isEmpty()) {
        return {};
    }

    QByteArray raw(6, 0);
    raw[1] = 0x01; // matches the behaviour observed in the original APK

    // Session bytes are provided little-endian – swap to match firmware expectations
    raw[2] = sessionSeed.size() > 1 ? static_cast<char>(sessionSeed.at(1)) : 0x00;
    raw[3] = static_cast<char>(sessionSeed.at(0));

    auto *rng = QRandomGenerator::system();
    raw[4] = static_cast<char>(rng->generate() & 0xFF);
    raw[5] = static_cast<char>(rng->generate() & 0xFF);

    return raw;
}

QByteArray computeHandshake(const QByteArray &handshakeRaw)
{
    if (handshakeRaw.size() != 6) {
        return {};
    }

    QByteArray padded(16, static_cast<char>(0x0A));
    std::copy(handshakeRaw.begin(), handshakeRaw.end(), padded.begin());

    auto expandKey = []() {
        std::array<unsigned char, 176> roundKeys{};
        auto &rk = roundKeys;
        for (int i = 0; i < 16; ++i) {
            rk[i] = kKettlerKey[i];
        }

        auto subWord = [](unsigned char x) -> unsigned char {
            static const unsigned char sbox[256] = {
                0x63,0x7c,0x77,0x7b,0xf2,0x6b,0x6f,0xc5,0x30,0x01,0x67,0x2b,0xfe,0xd7,0xab,0x76,
                0xca,0x82,0xc9,0x7d,0xfa,0x59,0x47,0xf0,0xad,0xd4,0xa2,0xaf,0x9c,0xa4,0x72,0xc0,
                0xb7,0xfd,0x93,0x26,0x36,0x3f,0xf7,0xcc,0x34,0xa5,0xe5,0xf1,0x71,0xd8,0x31,0x15,
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                0x8c,0xa1,0x89,0x0d,0xbf,0xe6,0x42,0x68,0x41,0x99,0x2d,0x0f,0xb0,0x54,0xbb,0x16
            };
            return sbox[x];
        };

        auto rotWord = [](unsigned char *w) {
            unsigned char tmp = w[0];
            w[0] = w[1];
            w[1] = w[2];
            w[2] = w[3];
            w[3] = tmp;
        };

        auto rcon = [](int round) {
            static const unsigned char rconTable[11] = {
                0x00, 0x01, 0x02, 0x04, 0x08, 0x10, 0x20, 0x40, 0x80, 0x1B, 0x36
            };
            return rconTable[round];
        };

        int bytesGenerated = 16;
        int rconIteration = 1;
        unsigned char temp[4];

        while (bytesGenerated < 176) {
            for (int i = 0; i < 4; ++i) {
                temp[i] = rk[bytesGenerated - 4 + i];
            }

            if (bytesGenerated % 16 == 0) {
                rotWord(temp);
                for (int i = 0; i < 4; ++i) {
                    temp[i] = subWord(temp[i]);
                }
                temp[0] ^= rcon(rconIteration++);
            }

            for (int i = 0; i < 4; ++i) {
                rk[bytesGenerated] = rk[bytesGenerated - 16] ^ temp[i];
                ++bytesGenerated;
            }
        }

        return roundKeys;
    };

    static const std::array<unsigned char, 176> roundKeys = expandKey();

    auto gmul = [](unsigned char a, unsigned char b) {
        unsigned char p = 0;
        for (int i = 0; i < 8; ++i) {
            if (b & 1) p ^= a;
            bool hiBit = a & 0x80;
            a <<= 1;
            if (hiBit) a ^= 0x1b;
            b >>= 1;
        }
        return p;
    };

    auto subBytes = [](unsigned char *state) {
        static const unsigned char sbox[256] = {
            0x63,0x7c,0x77,0x7b,0xf2,0x6b,0x6f,0xc5,0x30,0x01,0x67,0x2b,0xfe,0xd7,0xab,0x76,
            0xca,0x82,0xc9,0x7d,0xfa,0x59,0x47,0xf0,0xad,0xd4,0xa2,0xaf,0x9c,0xa4,0x72,0xc0,
            0xb7,0xfd,0x93,0x26,0x36,0x3f,0xf7,0xcc,0x34,0xa5,0xe5,0xf1,0x71,0xd8,0x31,0x15,
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            0x8c,0xa1,0x89,0x0d,0xbf,0xe6,0x42,0x68,0x41,0x99,0x2d,0x0f,0xb0,0x54,0xbb,0x16
        };
        for (int i = 0; i < 16; ++i) {
            state[i] = sbox[state[i]];
        }
    };

    auto shiftRows = [](unsigned char *state) {
        unsigned char tmp;
        // row 1
        tmp = state[1];
        state[1] = state[5];
        state[5] = state[9];
        state[9] = state[13];
        state[13] = tmp;
        // row 2
        tmp = state[2];
        unsigned char tmp2 = state[6];
        state[2] = state[10];
        state[6] = state[14];
        state[10] = tmp;
        state[14] = tmp2;
        // row 3
        tmp = state[3];
        state[3] = state[15];
        state[15] = state[11];
        state[11] = state[7];
        state[7] = tmp;
    };

    auto mixColumns = [&gmul](unsigned char *state) {
        for (int c = 0; c < 4; ++c) {
            unsigned char *col = state + c * 4;
            unsigned char a0 = col[0];
            unsigned char a1 = col[1];
            unsigned char a2 = col[2];
            unsigned char a3 = col[3];

            col[0] = gmul(a0, 2) ^ gmul(a1, 3) ^ a2 ^ a3;
            col[1] = a0 ^ gmul(a1, 2) ^ gmul(a2, 3) ^ a3;
            col[2] = a0 ^ a1 ^ gmul(a2, 2) ^ gmul(a3, 3);
            col[3] = gmul(a0, 3) ^ a1 ^ a2 ^ gmul(a3, 2);
        }
    };

    auto addRoundKey = [](unsigned char *state, const unsigned char *roundKey) {
        for (int i = 0; i < 16; ++i) {
            state[i] ^= roundKey[i];
        }
    };

    unsigned char state[16];
    std::copy(reinterpret_cast<const unsigned char *>(padded.constData()),
              reinterpret_cast<const unsigned char *>(padded.constData()) + 16,
              state);

    addRoundKey(state, roundKeys.data());

    for (int round = 1; round <= 9; ++round) {
        subBytes(state);
        shiftRows(state);
        mixColumns(state);
        addRoundKey(state, roundKeys.data() + 16 * round);
    }

    subBytes(state);
    shiftRows(state);
    addRoundKey(state, roundKeys.data() + 160);

    QByteArray cipher(reinterpret_cast<const char *>(state), 16);
    return cipher;
}

} // namespace kettler
